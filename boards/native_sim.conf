## module/dts/bindings/halo,emu-bma580.yaml
```yaml
# Copyright (c) 2025 Brilliant Labs
# SPDX-License-Identifier: Apache-2.0

description: |
  Emulated BMA580 accelerometer (module/src/fake_sensors.c), wired as chosen
  zephyr,accel for lua_imu.c. Reports a fixed level-orientation gravity
  vector and swallows the BMA580-private attributes until ticket 0012 adds
  settable vectors and tap injection.

compatible: "halo,emu-bma580"

include: sensor-device.yaml
```

## module/dts/bindings/halo,emu-qmc6308.yaml
```yaml
# Copyright (c) 2025 Brilliant Labs
# SPDX-License-Identifier: Apache-2.0

description: |
  Emulated QMC6308 magnetometer (module/src/fake_sensors.c), wired as chosen
  zephyr,magn for lua_imu.c. Zero vector until ticket 0012.

compatible: "halo,emu-qmc6308"

include: sensor-device.yaml
```

## module/dts/bindings/halo,emu-vbat.yaml
```yaml
# Copyright (c) 2025 Brilliant Labs
# SPDX-License-Identifier: Apache-2.0

description: |
  Emulated Halo battery gauge (module/src/fake_sensors.c). Node must carry
  the label `vbat` — battery_manager.c and lua_system.c look it up by
  DT_NODELABEL. Fixed 4000 mV / 80% / not-charging until ticket 0011 makes
  the values control-plane-settable.

compatible: "halo,emu-vbat"

include: sensor-device.yaml
```
